;
; BootROM variables and functions
;

VIRQ	equ	VEC_IRQ_ADDR
VSWI	equ	VEC_SWI_ADDR
VNMI	equ	VEC_NMI_ADDR

END_ADDR	equ	$F0

BOOTROM_BASE	equ	$F800

F_RESET		equ	BOOTROM_BASE
F_UART_IN	equ	BOOTROM_BASE+3*1
F_UART_OUT	equ	BOOTROM_BASE+3*2
F_UART_PUTS	equ	BOOTROM_BASE+3*3
F_UART_OUTHEX	equ	BOOTROM_BASE+3*4
F_SETVIDEOMODE	equ	BOOTROM_BASE+3*5
F_SPI_RESET	equ	BOOTROM_BASE+3*6
F_SPI_GETSTAT	equ	BOOTROM_BASE+3*7
F_SPI_SELECT	equ	BOOTROM_BASE+3*8
F_SPI_WRITE	equ	BOOTROM_BASE+3*9
F_SPI_READ	equ	BOOTROM_BASE+3*10
F_SD_INIT	equ	BOOTROM_BASE+3*11
F_SD_READ	equ	BOOTROM_BASE+3*12
F_SD_WRITE	equ	BOOTROM_BASE+3*13
F_SD_FLUSH	equ	BOOTROM_BASE+3*14
F_PSG_WRITE	equ	BOOTROM_BASE+3*15
